## examples/esp32-p4-devkit-host-midi2/idf/sdkconfig.defaults
```kconfig
# ESP-IDF target + console
# UART stdio on the CH343 USB-to-UART bridge ("ToUART" USB-C jack on
# the Waveshare ESP32-P4-WIFI6-DEV-KIT). The host role uses the UTMI
# PHY routed to the USB-A jacks; the USB-Device USB-C jack stays free
# (the future bridge variant claims it for the device side).
CONFIG_IDF_TARGET="esp32p4"
CONFIG_ESP_CONSOLE_UART_DEFAULT=y
# Secondary console on USB-Serial-JTAG (panic backtraces visible during
# early boot debug; coexists with TinyUSB host on UTMI because the two
# USB controllers are independent on P4).
CONFIG_ESP_CONSOLE_SECONDARY_USB_SERIAL_JTAG=y
CONFIG_ESPTOOLPY_FLASHSIZE_16MB=y
CONFIG_PARTITION_TABLE_CUSTOM=y
CONFIG_PARTITION_TABLE_CUSTOM_FILENAME="partitions.csv"

# Host stack pulls in tuh_task + auto-discovery + CI Initiator state
# machine (m2host). 8 KB main task stack covers the worst case during
# host.begin() and the first mount callback.
CONFIG_ESP_MAIN_TASK_STACK_SIZE=8192

# P4 default core clock 360 MHz (HP CPU), kept default so the build
# does not depend on an option that may rename across IDF versions.

# Compiler: C++17 to match the parent library and Pico SDK recipes.
# midi2cpp uses std::function callbacks; exceptions stay off.
CONFIG_COMPILER_CXX_EXCEPTIONS=n
CONFIG_COMPILER_OPTIMIZATION_PERF=y

# Note: TinyUSB MIDI 2.0 toggles live in main/tusb_config.h
# (CFG_TUD_MIDI2 etc), not in Kconfig, because the shim component at
# components/tinyusb registers TinyUSB sources directly without going
# through the Espressif esp_tinyusb Kconfig.
```

## examples/esp32-p4-devkit-usb-midi2/idf/sdkconfig.defaults
```kconfig
# ESP-IDF target + console
# UART stdio on the CH343 USB-to-UART bridge ("ToUART" USB-C jack on
# the Waveshare ESP32-P4-WIFI6-DEV-KIT). The "USB-Device" USB-C jack
# is the native USB-OTG that carries MIDI 2.0; do NOT enable USB-CDC
# stdio, it would steal endpoints from TinyUSB.
CONFIG_IDF_TARGET="esp32p4"
CONFIG_ESP_CONSOLE_UART_DEFAULT=y
# Secondary console on USB-Serial-JTAG (P4 has separate USB-Serial-JTAG
# and USB-OTG controllers, so this can coexist with TinyUSB MIDI 2.0
# on the USB-Device jack). Enables panic backtraces visible during
# early boot debugging when the CH343-routed UART has not been wired
# to the right pins on a custom board.
CONFIG_ESP_CONSOLE_SECONDARY_USB_SERIAL_JTAG=y
CONFIG_ESPTOOLPY_FLASHSIZE_16MB=y
CONFIG_PARTITION_TABLE_CUSTOM=y
CONFIG_PARTITION_TABLE_CUSTOM_FILENAME="partitions.csv"

# P4 default core clock 360 MHz (HP CPU), kept default so the build
# does not depend on an option that may rename across IDF versions.

# Compiler: C++17 to match the parent library and Pico SDK recipes.
# midi2_cpp uses std::function callbacks; exceptions stay off.
CONFIG_COMPILER_CXX_EXCEPTIONS=n
CONFIG_COMPILER_OPTIMIZATION_PERF=y

# Note: TinyUSB MIDI 2.0 toggles live in main/tusb_config.h
# (CFG_TUD_MIDI2 etc), not in Kconfig, because the shim component at
# components/tinyusb registers TinyUSB sources directly without going
# through the Espressif esp_tinyusb Kconfig.
```

## examples/esp32-s3-devkitc-usb-midi2/idf/sdkconfig.defaults
```kconfig
# ESP-IDF target + console
# UART stdio on the USB-to-UART bridge (left USB jack on the DevKitC-1).
# The right USB jack is the native USB-OTG that carries MIDI 2.0; do NOT
# enable USB-CDC stdio, it would steal endpoints from TinyUSB.
CONFIG_IDF_TARGET="esp32s3"
CONFIG_ESP_CONSOLE_UART_DEFAULT=y
CONFIG_ESPTOOLPY_FLASHSIZE_8MB=y
CONFIG_PARTITION_TABLE_CUSTOM=y
CONFIG_PARTITION_TABLE_CUSTOM_FILENAME="partitions.csv"

# CPU at full speed for tighter UMP loop timing.
CONFIG_ESP_DEFAULT_CPU_FREQ_MHZ_240=y

# Compiler: C++17 to match the parent library and Pico SDK recipes.
# midi2_cpp uses std::function callbacks; exceptions stay off.
CONFIG_COMPILER_CXX_EXCEPTIONS=n
CONFIG_COMPILER_OPTIMIZATION_PERF=y

# Note: TinyUSB MIDI 2.0 toggles live in main/tusb_config.h
# (CFG_TUD_MIDI2 etc), not in Kconfig, because the shim component at
# components/tinyusb registers TinyUSB sources directly without going
# through the Espressif esp_tinyusb Kconfig.
```

## examples/t-display-s3-midi2/idf/sdkconfig.defaults
```kconfig
# T-Display S3 specific defaults for t-display-s3-midi2 (ESP32-S3R8, 16 MB
# flash, 8 MB PSRAM Octal, single USB-C port driven by the native USB-OTG
# peripheral when this firmware runs).

CONFIG_IDF_TARGET="esp32s3"

# Flash + partitions. T-Display S3 ships with 16 MB QIO flash.
CONFIG_ESPTOOLPY_FLASHSIZE_16MB=y
CONFIG_ESPTOOLPY_FLASHMODE_QIO=y
CONFIG_ESPTOOLPY_FLASHFREQ_80M=y
CONFIG_PARTITION_TABLE_CUSTOM=y
CONFIG_PARTITION_TABLE_CUSTOM_FILENAME="partitions.csv"

# PSRAM 8 MB Octal (ESP32-S3R8 die marker on the T-Display S3 module).
# The piano UI's full-screen sprite (320x170 16bpp = ~108 KB) lives in
# PSRAM; without this the sprite alloc fails on init.
CONFIG_SPIRAM=y
CONFIG_SPIRAM_MODE_OCT=y
CONFIG_SPIRAM_SPEED_80M=y
CONFIG_SPIRAM_USE_MALLOC=y
CONFIG_SPIRAM_BOOT_INIT=y

# CPU at full speed for tighter UMP loop timing + display render budget.
CONFIG_ESP_DEFAULT_CPU_FREQ_MHZ_240=y

# Console: UART0 (GP43 TX / GP44 RX on the T-Display S3 IO header). The
# board has no on-board USB-to-UART bridge; runtime logs require an
# external USB-TTL adapter wired to those pins. USB-Serial-JTAG is OFF
# at runtime because the single USB-C port is owned by TinyUSB MIDI 2.0
# while the firmware is running.
CONFIG_ESP_CONSOLE_UART_DEFAULT=y
CONFIG_ESP_CONSOLE_USB_SERIAL_JTAG_ENABLED=n

# Compiler: C++17 to match the parent library. midi2cpp uses
# std::function callbacks; exceptions stay off.
CONFIG_COMPILER_CXX_EXCEPTIONS=n
CONFIG_COMPILER_OPTIMIZATION_PERF=y

# Note: TinyUSB MIDI 2.0 toggles live in main/tusb_config.h
# (CFG_TUD_MIDI2 etc), not in Kconfig, because the shim component at
# components/tinyusb registers TinyUSB sources directly without going
# through the Espressif esp_tinyusb Kconfig.
```
